## drivers/tee/qcomtee/Kconfig
```kconfig
# SPDX-License-Identifier: GPL-2.0-only
# Qualcomm Trusted Execution Environment Configuration
config QCOMTEE
	tristate "Qualcomm TEE Support"
	depends on ARCH_QCOM || COMPILE_TEST
	depends on !CPU_BIG_ENDIAN
	select QCOM_SCM
	select QCOM_TZMEM_MODE_SHMBRIDGE
	help
	  This option enables the Qualcomm Trusted Execution Environment (QTEE)
	  driver. It provides an API to access services offered by QTEE and
	  its loaded Trusted Applications (TAs). Additionally, it facilitates
	  the export of userspace services provided by supplicants to QTEE.

config QCOMTEE_UEFISECAPP
	bool "QTEE transport and RPMB backing for Qualcomm UEFI variables"
	depends on QCOMTEE
	depends on QCOM_QSEECOM_UEFISECAPP
	depends on RPMB
	help
	  Connect the existing Qualcomm UEFI Secure App client to the QTEE
	  QSEECom compatibility service. A kernel listener routes secure-world
	  RPMB requests to the UFS RPMB subsystem without a userspace daemon.

	  This is currently enabled only for the OnePlus Iceland platform.
```
