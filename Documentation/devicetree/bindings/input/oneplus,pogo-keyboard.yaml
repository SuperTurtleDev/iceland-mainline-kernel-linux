## Documentation/devicetree/bindings/power/supply/oplus,wls-tx-mt5806.yaml
```yaml
# SPDX-License-Identifier: (GPL-2.0-only OR BSD-2-Clause)
%YAML 1.2
---
$id: http://devicetree.org/schemas/power/supply/oplus,wls-tx-mt5806.yaml#
$schema: http://devicetree.org/meta-schemas/core.yaml#

title: Oplus pencil wireless charging transmitter (MT5806)

maintainers:
  - Yibo Wang <wyibo6109@gmail.com>

description:
  The MT5806 wireless power transmitter charges the stylus docked on the
  magnetic strip of Oplus tablets and relays the pencil's identity packets.
  Its input rail is a PMIC boost whose voltage is raised while a pencil is
  attached.

allOf:
  - $ref: power-supply.yaml#

properties:
  compatible:
    const: oplus,wls-tx-mt5806

  reg:
    maxItems: 1

  interrupts:
    maxItems: 1

  hboost-supply:
    description: Transmitter input rail with programmable voltage.

  power-gpios:
    maxItems: 1
    description: Switch feeding the transmitter from the HBOOST rail.

  wakeup-gpios:
    maxItems: 1
    description: Held active while the transmitter firmware boots.

  scan-gpios:
    maxItems: 1
    description:
      Active selects the fast pencil scan interval used while the system is
      awake; inactive the slow interval.

  charge-off-gpios:
    maxItems: 1
    description: Active blocks power transfer to the pencil.

  oplus,hboost-idle-microvolt:
    minimum: 2000000
    maximum: 14750000
    multipleOf: 50000
    default: 5800000
    description: HBOOST voltage while no pencil is attached.

  oplus,hboost-charge-microvolt:
    minimum: 2000000
    maximum: 14750000
    multipleOf: 50000
    description:
      HBOOST voltage while a pencil is attached. Defaults to the idle
      voltage.

  oplus,recharge-soc-percent:
    maximum: 100
    default: 90
    description:
      Pencil state of charge, reported by userspace, at or below which a
      full pencil is charged again.

  oplus,charge-timeout-sec:
    minimum: 1
    default: 7200
    description: Longest charging session before power transfer stops.

required:
  - compatible
  - reg
  - interrupts
  - hboost-supply
  - power-gpios
  - wakeup-gpios
  - scan-gpios
  - charge-off-gpios

unevaluatedProperties: false

examples:
  - |
    #include <dt-bindings/gpio/gpio.h>
    #include <dt-bindings/interrupt-controller/irq.h>

    i2c {
        #address-cells = <1>;
        #size-cells = <0>;

        charger@2b {
            compatible = "oplus,wls-tx-mt5806";
            reg = <0x2b>;
            interrupts-extended = <&tlmm 169 IRQ_TYPE_EDGE_FALLING>;
            hboost-supply = <&pencil_hboost>;
            power-gpios = <&pmic_gpios 8 GPIO_ACTIVE_HIGH>;
            wakeup-gpios = <&pmic_gpios 2 GPIO_ACTIVE_HIGH>;
            scan-gpios = <&pmic_gpios 7 GPIO_ACTIVE_HIGH>;
            charge-off-gpios = <&pmic_gpios 11 GPIO_ACTIVE_HIGH>;
            oplus,hboost-idle-microvolt = <7000000>;
            oplus,hboost-charge-microvolt = <10000000>;
            oplus,recharge-soc-percent = <80>;
        };
    };
```

## Documentation/devicetree/bindings/power/supply/southchip,sc8547d.yaml
```yaml
# SPDX-License-Identifier: (GPL-2.0-only OR BSD-2-Clause)
%YAML 1.2
---
$id: http://devicetree.org/schemas/power/supply/southchip,sc8547d.yaml#
$schema: http://devicetree.org/meta-schemas/core.yaml#

title: Southchip SC8547D charge pump

maintainers:
  - Yibo Wang <wyibo6109@gmail.com>

description:
  2:1 switched capacitor charge pump with built-in VOOC and UFCS PHYs on D+/D-.
  The pump is driven by a direct charging driver that references it; it does
  not charge on its own.

properties:
  compatible:
    const: southchip,sc8547d

  reg:
    maxItems: 1

  interrupts:
    maxItems: 1

  southchip,vbat-ovp-microvolt:
    description: Battery over-voltage protection, 3.5 V to 5.075 V in 25 mV steps.
    minimum: 3500000
    maximum: 5075000
    default: 4850000

  southchip,vbus-ovp-microvolt:
    description: Input over-voltage protection, 6 V to 12.35 V in 50 mV steps.
    minimum: 6000000
    maximum: 12350000
    default: 10500000

  southchip,ibus-ocp-microamp:
    description: Input over-current protection, 1.2 A to 5.7 A in 300 mA steps.
    minimum: 1200000
    maximum: 5700000
    default: 5700000

  southchip,switching-frequency-hz:
    enum: [500000, 600000]
    default: 500000

  southchip,always-otg-en:
    type: boolean
    description: Keep the OTG path of the pump enabled.

  southchip,vooc-phy:
    type: boolean
    description: The VOOC PHY of this pump is wired to the connector D+/D-.

  southchip,ufcs-phy:
    type: boolean
    description: The UFCS PHY of this pump is wired to the connector D+/D-.

required:
  - compatible
  - reg

allOf:
  - if:
      anyOf:
        - required: [southchip,vooc-phy]
        - required: [southchip,ufcs-phy]
    then:
      required:
        - interrupts

additionalProperties: false

examples:
  - |
    #include <dt-bindings/interrupt-controller/irq.h>
    i2c {
        #address-cells = <1>;
        #size-cells = <0>;

        charge-pump@6a {
            compatible = "southchip,sc8547d";
            reg = <0x6a>;
            interrupts-extended = <&tlmm 0 IRQ_TYPE_EDGE_FALLING>;
            southchip,vbat-ovp-microvolt = <4850000>;
            southchip,vbus-ovp-microvolt = <10500000>;
            southchip,ibus-ocp-microamp = <5700000>;
            southchip,vooc-phy;
            southchip,ufcs-phy;
        };
    };
```

## Documentation/devicetree/bindings/regulator/qcom,rpmh-xob-regulator.yaml
```yaml
# SPDX-License-Identifier: (GPL-2.0-only OR BSD-2-Clause)
%YAML 1.2
---
$id: http://devicetree.org/schemas/regulator/qcom,rpmh-xob-regulator.yaml#
$schema: http://devicetree.org/meta-schemas/core.yaml#

title: Qualcomm RPMh on/off resource regulator

maintainers:
  - Yibo Wang <wyibo6109@gmail.com>

description:
  An RPMh resource that only supports being switched on or off, such as a
  PMIC bidirectional GPIO level shifter. The node is a child of the RSC
  device node and is voted on by its command database name.

allOf:
  - $ref: regulator.yaml#

properties:
  compatible:
    const: qcom,rpmh-xob-regulator

  qcom,resource-name:
    $ref: /schemas/types.yaml#/definitions/string
    description: Command database name of the resource, for example LS3B_E0.

required:
  - compatible
  - qcom,resource-name

unevaluatedProperties: false

examples:
  - |
    rsc {
        regulator-ls3b {
            compatible = "qcom,rpmh-xob-regulator";
            qcom,resource-name = "LS3B_E0";
            regulator-name = "pmh0101_ls3";
            regulator-always-on;
        };
    };
```

## Documentation/devicetree/bindings/thermal/oplus,shell-temperature.yaml
```yaml
# SPDX-License-Identifier: (GPL-2.0-only OR BSD-2-Clause)
%YAML 1.2
---
$id: http://devicetree.org/schemas/thermal/oplus,shell-temperature.yaml#
$schema: http://devicetree.org/meta-schemas/core.yaml#

title: OnePlus shell temperature estimator

maintainers:
  - Yibo Wang <wyibo6109@gmail.com>

description: |
  Estimates the device shell temperature from thermal zones and the battery
  with the linear model of the stock OnePlus thermal daemon. Each model-*
  child node is one model over the last few samples:

    Y = sum over history k and input i of C[k][i] * T[k][i] + b

  The zone reports the largest model output. Until a model's history is
  full it reports the battery temperature plus its bias; a gap longer than
  the reset interval between samples starts the history over.

properties:
  compatible:
    const: oplus,shell-temperature

  "#thermal-sensor-cells":
    const: 0

  oplus,thermal-zones:
    $ref: /schemas/types.yaml#/definitions/string-array
    minItems: 1
    maxItems: 8
    description: Input thermal zones, numbered from 0 in this order.

  oplus,battery:
    $ref: /schemas/types.yaml#/definitions/string
    description: Power supply whose temperature is the last input.

  oplus,period-ms:
    default: 5000

  oplus,history-reset-ms:
    default: 8000

patternProperties:
  "^model-[a-z0-9-]+$":
    type: object
    additionalProperties: false
    properties:
      oplus,inputs:
        $ref: /schemas/types.yaml#/definitions/uint32-array
        description: Input indexes; the number of thermal zones selects the battery.
      oplus,history:
        $ref: /schemas/types.yaml#/definitions/uint32
        minimum: 1
        maximum: 4
        description: Number of past samples the model spans.
      oplus,coefficients-micro:
        $ref: /schemas/types.yaml#/definitions/int32-matrix
        description: One row per history sample, newest first, in millionths.
      oplus,constant-microcelsius:
        $ref: /schemas/types.yaml#/definitions/int32
        description: Model constant b in millionths of a degree Celsius.
      oplus,battery-bias-millicelsius:
        description: Added to the battery temperature while the history fills.
    required:
      - oplus,inputs
      - oplus,history
      - oplus,coefficients-micro
      - oplus,constant-microcelsius
      - oplus,battery-bias-millicelsius

required:
  - compatible
  - "#thermal-sensor-cells"
  - oplus,thermal-zones
  - oplus,battery

additionalProperties: false

examples:
  - |
    shell-temperature {
        compatible = "oplus,shell-temperature";
        #thermal-sensor-cells = <0>;
        oplus,thermal-zones = "skin", "board";
        oplus,battery = "battery";

        model-back {
            oplus,inputs = <0 1 2>;
            oplus,history = <2>;
            oplus,coefficients-micro = <500000 (-100000) 600000>,
                                       <100000 100000 (-200000)>;
            oplus,constant-microcelsius = <456600>;
            oplus,battery-bias-millicelsius = <2000>;
        };
    };
```
