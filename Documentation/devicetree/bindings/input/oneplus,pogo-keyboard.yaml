## Documentation/devicetree/bindings/input/oneplus,pogo-keyboard.yaml
```yaml
# SPDX-License-Identifier: (GPL-2.0-only OR BSD-2-Clause)
# Copyright (c) 2026 Yibo Wang <wyibo6109@gmail.com>
%YAML 1.2
---
$id: http://devicetree.org/schemas/input/oneplus,pogo-keyboard.yaml#
$schema: http://devicetree.org/meta-schemas/core.yaml#

title: OnePlus / OPPO Pad pogo-pin smart keyboard

maintainers:
  - Yibo Wang <wyibo6109@gmail.com>

description: |
  The Tinno keyboard MCU used by the OnePlus Pad 3 Pro / Pad 4 and OPPO
  Pad 5 Pro smart keyboards.  It is attached to a tablet UART and speaks
  a framed half-duplex protocol over a shared single wire; host
  transmission is gated onto the wire by a PMIC GPIO for the duration of
  a frame.  The device provides a keyboard matrix, a touchpad and a
  keyboard backlight.

allOf:
  - $ref: /schemas/serial/serial-peripheral-props.yaml#
  - $ref: /schemas/input/touchscreen/touchscreen.yaml#

properties:
  compatible:
    description: |
      Names the tablet project the pogo port belongs to, which pins the
      keyboard MCU generation and the protocol extensions the host may
      use: caihong (sm8650 era) supports neither the wake notification
      nor a backlight, erhai (sm8750 era) adds the wake notification,
      iceland (sm8850 era) adds the keyboard backlight.
    enum:
      - oneplus,caihong-pogo-keyboard
      - oneplus,erhai-pogo-keyboard
      - oneplus,iceland-pogo-keyboard

  power-gpios:
    description: GPIO enabling the keyboard supply, held high while attached.
    maxItems: 1

  tx-enable-gpios:
    description: GPIO gating host TX onto the shared one-wire bus.
    maxItems: 1

  wake-gpios:
    description: GPIO signalling attach/detach, also used as the wake line.
    maxItems: 1

  touchscreen-size-x: true
  touchscreen-size-y: true
  touchscreen-x-mm: true
  touchscreen-y-mm: true

required:
  - compatible
  - power-gpios
  - tx-enable-gpios
  - wake-gpios

unevaluatedProperties: false

examples:
  - |
    #include <dt-bindings/gpio/gpio.h>

    keyboard {
        compatible = "oneplus,iceland-pogo-keyboard";
        power-gpios = <&pmic_gpios 12 GPIO_ACTIVE_HIGH>;
        tx-enable-gpios = <&pmic2_gpios 6 GPIO_ACTIVE_HIGH>;
        wake-gpios = <&tlmm 151 GPIO_ACTIVE_LOW>;
    };
...
```

## Documentation/devicetree/bindings/media/i2c/dongwoon,dw9719.yaml
```yaml
# SPDX-License-Identifier: (GPL-2.0-only OR BSD-2-Clause)
%YAML 1.2
---
$id: http://devicetree.org/schemas/media/i2c/dongwoon,dw9719.yaml#
$schema: http://devicetree.org/meta-schemas/core.yaml#

title: Dongwoon Anatech DW9719 Voice Coil Motor (VCM) Controller

maintainers:
  - André Apitzsch <git@apitzsch.eu>

description:
  The Dongwoon DW9718S/9719/9761/9800K are single 10-bit digital-to-analog
  converters with 100 mA output current sink capability, designed for linear
  control of voice coil motors (VCM) in camera lenses. These chips provide a
  Smart Actuator Control (SAC) mode intended for driving voice coil lenses
  in camera modules. The DW9714V is a DW9714 successor which additionally
  provides a register-mapped ("advanced") mode with the DW9719 register
  layout and SAC2/SAC3/SAC4 ringing control, entered by an I2C command
  sequence.

properties:
  compatible:
    enum:
      - dongwoon,dw9714v
      - dongwoon,dw9718s
      - dongwoon,dw9719
      - dongwoon,dw9761
      - dongwoon,dw9800k

  reg:
    maxItems: 1

  vdd-supply:
    description: VDD power supply

  dongwoon,sac-mode:
    description: |
      Slew Rate Control mode to use: direct, LSC (Linear Slope Control) or
      SAC1-SAC6 (Smart Actuator Control).
    $ref: /schemas/types.yaml#/definitions/uint32
    enum:
      - 0   # Direct mode
      - 1   # LSC mode
      - 2   # SAC1 mode (operation time# 0.32 x Tvib)
      - 3   # SAC2 mode (operation time# 0.48 x Tvib)
      - 4   # SAC3 mode (operation time# 0.72 x Tvib)
      - 5   # SAC4 mode (operation time# 1.20 x Tvib)
      - 6   # SAC5 mode (operation time# 1.64 x Tvib)
      - 7   # SAC6 mode (operation time# 1.88 x Tvib)
    default: 4

  dongwoon,vcm-prescale:
    description:
      Indication of VCM switching frequency dividing rate select.
    $ref: /schemas/types.yaml#/definitions/uint32

  dongwoon,sac-ring-enable:
    description:
      Enable the ringing control block (SAC_CFG RING_EN). When absent, the
      DAC is driven directly (DW9714-compatible behavior) and
      dongwoon,sac-mode has no effect.
    type: boolean

required:
  - compatible
  - reg
  - vdd-supply

allOf:
  - if:
      properties:
        compatible:
          contains:
            const: dongwoon,dw9718s
    then:
      properties:
        dongwoon,vcm-prescale:
          description:
            The final frequency is 10 MHz divided by (value + 2).
          maximum: 15
          default: 0

  - if:
      properties:
        compatible:
          contains:
            const: dongwoon,dw9714v
    then:
      properties:
        dongwoon,sac-mode:
          description:
            SAC2, SAC3 or SAC4 ringing control mode.
          enum: [3, 4, 5]
        dongwoon,vcm-prescale:
          description:
            Value of the VCM_FREQ register. Bits 7:6 select the ringing
            control period divider (2, 1, 1/2, 1/4), bits 5:0 the period,
            which has to match the mechanical vibration period (tVIB) of
            the actuator and lens assembly of the camera module.
          maximum: 255
          default: 0x60
    else:
      properties:
        dongwoon,sac-ring-enable: false

additionalProperties: false

examples:
  - |
    i2c {
        #address-cells = <1>;
        #size-cells = <0>;

        actuator@c {
            compatible = "dongwoon,dw9718s";
            reg = <0x0c>;

            vdd-supply = <&pm8937_l17>;

            dongwoon,sac-mode = <4>;
            dongwoon,vcm-prescale = <0>;
        };
    };

  - |
    i2c {
        #address-cells = <1>;
        #size-cells = <0>;

        actuator@c {
            compatible = "dongwoon,dw9714v";
            reg = <0x0c>;

            vdd-supply = <&vreg_l16b_2p8>;

            dongwoon,sac-ring-enable;
            dongwoon,sac-mode = <3>;
            dongwoon,vcm-prescale = <0x79>;
        };
    };
```

## Documentation/devicetree/bindings/power/supply/oplus,iceland-pmic-pps.yaml
```yaml
# SPDX-License-Identifier: (GPL-2.0-only OR BSD-2-Clause)
%YAML 1.2
---
$id: http://devicetree.org/schemas/power/supply/oplus,iceland-pmic-pps.yaml#
$schema: http://devicetree.org/meta-schemas/core.yaml#

title: OnePlus Iceland PMIC USB PPS charger

maintainers:
  - Yibo Wang <wyibo6109@gmail.com>

description: |
  PPS charging policy for the ADSP-controlled PMIC buck on OnePlus Iceland.
  The device is a board-level platform device, referencing the PMIC GLINK
  transport. It does not represent an external charge pump. Commands share
  the existing battery-manager transaction lock. Runtime limits are the
  intersection of one PPS APDO and the board limits of 10.5 V and 3 A.
  The default table follows the Oplus third-party PPS strategy. Battery
  temperature is used because this board has no mainline shell sensor.

properties:
  compatible:
    const: oplus,iceland-pmic-pps

  oplus,pmic-glink:
    $ref: /schemas/types.yaml#/definitions/phandle
    description: PMIC GLINK device providing the battery-manager supplies.

  oplus,pps-charge-curve:
    $ref: /schemas/types.yaml#/definitions/uint32-matrix
    description: |
      Rows are SOC lower and upper bounds (inclusive, percent), temperature
      lower and upper bounds (half-open, deci-Celsius), gear number, source
      voltage (mV), battery voltage threshold (mV), source current (mA), flags,
      and gear timeout (seconds, zero disables). Flags are bit 0 last gear and
      bit 1 constant-voltage dwell. Each group starts at gear zero, consecutive
      gears share the SOC/temperature bounds, and the last gear sets bit 0.
      Groups must not overlap. Voltages and currents may exceed board limits;
      requests are always clamped to one real APDO and the board limits.
    minItems: 1
    maxItems: 512
    items:
      items:
        - minimum: 0
          maximum: 100
        - minimum: 0
          maximum: 100
        - minimum: 0
          maximum: 599
        - minimum: 1
          maximum: 600
        - minimum: 0
          maximum: 63
        - minimum: 5500
          maximum: 21000
        - minimum: 2500
          maximum: 4560
        - minimum: 100
          maximum: 15000
          multipleOf: 50
        - minimum: 0
          maximum: 3
        - minimum: 0
          maximum: 86400

required:
  - compatible
  - oplus,pmic-glink
  - oplus,pps-charge-curve

additionalProperties: false

examples:
  - |
    charger-pps {
        compatible = "oplus,iceland-pmic-pps";
        oplus,pmic-glink = <&pmic_glink>;
        oplus,pps-charge-curve = <0 90 160 450 0 9000 4490 2000 1 0>;
    };
```
