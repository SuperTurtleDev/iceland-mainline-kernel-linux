// SPDX-License-Identifier: GPL-2.0-only
/*
 * Iceland third-party charging curves and low-current-full tables from the
 * public OnePlus SM8850 source, commit 8be53e8b737a83a33512d5e0106cccb010a5c24c:
 * kernel_platform/qcom/opensource/devicetree/oplus/oplus_chg/iceland_ivy/
 * oplus-chg-iceland-common.dtsi (pps_charge_third_strategy,
 * ufcs_charge_third_strategy, *_third_lcf_strategy, svooc_lcf_strategy) and
 * oplus-chg-iceland-80w.dtsi (svooc_charge_strategy, EU 80 W model); the
 * VOOC 2.0/3.0 bypass curve is vooc_charge_strategy of the common file.
 * Corrected the bypass 56-75% warm row to 2000 mA: OEM uses 2000 instead
 * of 20 in a 100 mA field; adjacent warm rows use 20.
 * Copyright (C) 2020-2024 Oplus. All rights reserved.
 *
 * Generated by debug/iceland-dtb/tools/gen-fastcharge-curves.py. Do not edit.
 * Curve rows: soc_lo soc_hi temp_lo temp_hi gear vbus_mv vbat_mv ibus_ma flags seconds.
 * SOC bounds are inclusive, temperature bounds half-open in 0.1 C. Flags: bit 0
 * last gear, bit 1 constant-voltage dwell. SuperVOOC rows carry no adapter
 * voltage. Low-current-full rows: temp_lo temp_hi iterm_ma vterm_mv exit.
 */


&fastchg_pps {
	oplus,charge-curve =
		<0 20 0 50 0 11000 4150 5000 0 0>,
		<0 20 0 50 1 11000 4150 4500 0 0>,
		<0 20 0 50 2 11000 4490 4250 0 0>,
		<0 20 0 50 3 11000 4490 4000 0 0>,
		<0 20 0 50 4 11000 4490 3500 0 0>,
		<0 20 0 50 5 11000 4490 3000 0 0>,
		<0 20 0 50 6 11000 4490 2500 0 0>,
		<0 20 0 50 7 11000 4490 2000 0 0>,
		<0 20 0 50 8 11000 4490 1500 0 0>,
		<0 20 0 50 9 11000 4500 1000 1 0>,
		<0 20 50 120 0 11000 4150 5000 0 0>,
		<0 20 50 120 1 11000 4150 4500 0 0>,
		<0 20 50 120 2 11000 4490 4250 0 0>,
		<0 20 50 120 3 11000 4490 4000 0 0>,
		<0 20 50 120 4 11000 4490 3500 0 0>,
		<0 20 50 120 5 11000 4490 3000 0 0>,
		<0 20 50 120 6 11000 4490 2500 0 0>,
		<0 20 50 120 7 11000 4490 2000 0 0>,
		<0 20 50 120 8 11000 4490 1500 0 0>,
		<0 20 50 120 9 11000 4500 1000 1 0>,
		<0 20 120 160 0 11000 4480 5000 0 0>,
		<0 20 120 160 1 11000 4490 4950 0 0>,
		<0 20 120 160 2 11000 4490 4500 0 0>,
		<0 20 120 160 3 11000 4490 4000 0 0>,
		<0 20 120 160 4 11000 4490 3500 0 0>,
		<0 20 120 160 5 11000 4490 3000 0 0>,
		<0 20 120 160 6 11000 4490 2500 0 0>,
		<0 20 120 160 7 11000 4490 2000 0 0>,
		<0 20 120 160 8 11000 4490 1500 0 0>,
		<0 20 120 160 9 11000 4500 1000 1 0>,
		<0 20 160 210 0 11000 4480 5000 0 0>,
		<0 20 160 210 1 11000 4490 4950 0 0>,
		<0 20 160 210 2 11000 4490 4500 0 0>,
		<0 20 160 210 3 11000 4490 4000 0 0>,
		<0 20 160 210 4 11000 4490 3500 0 0>,
		<0 20 160 210 5 11000 4490 3000 0 0>,
		<0 20 160 210 6 11000 4490 2500 0 0>,
		<0 20 160 210 7 11000 4490 2000 0 0>,
		<0 20 160 210 8 11000 4490 1500 0 0>,
		<0 20 160 210 9 11000 4500 1000 1 0>,
		<0 20 210 350 0 11000 4480 5000 0 0>,
		<0 20 210 350 1 11000 4490 4950 0 0>,
		<0 20 210 350 2 11000 4490 4500 0 0>,
		<0 20 210 350 3 11000 4490 4000 0 0>,
		<0 20 210 350 4 11000 4490 3500 0 0>,
		<0 20 210 350 5 11000 4490 3000 0 0>,
		<0 20 210 350 6 11000 4490 2500 0 0>,
		<0 20 210 350 7 11000 4490 2000 0 0>,
		<0 20 210 350 8 11000 4490 1500 0 0>,
		<0 20 210 350 9 11000 4500 1000 1 0>,
		<0 20 350 440 0 11000 4470 5000 0 0>,
		<0 20 350 440 1 11000 4470 4950 0 0>,
		<0 20 350 440 2 11000 4470 4500 0 0>,
		<0 20 350 440 3 11000 4470 4000 0 0>,
		<0 20 350 440 4 11000 4470 3500 0 0>,
		<0 20 350 440 5 11000 4470 3000 0 0>,
		<0 20 350 440 6 11000 4470 2500 0 0>,
		<0 20 350 440 7 11000 4470 2000 0 0>,
		<0 20 350 440 8 11000 4470 1500 0 0>,
		<0 20 350 440 9 11000 4480 1000 1 0>,
		<0 20 440 510 0 11000 4120 3250 0 0>,
		<0 20 440 510 1 11000 4120 3000 0 0>,
		<0 20 440 510 2 11000 4120 2500 0 0>,
		<0 20 440 510 3 11000 4120 2000 0 0>,
		<0 20 440 510 4 11000 4120 1500 0 0>,
		<0 20 440 510 5 11000 4130 1000 1 0>,
		<21 35 0 50 0 11000 4150 5000 0 0>,
		<21 35 0 50 1 11000 4150 4500 0 0>,
		<21 35 0 50 2 11000 4490 4250 0 0>,
		<21 35 0 50 3 11000 4490 4000 0 0>,
		<21 35 0 50 4 11000 4490 3500 0 0>,
		<21 35 0 50 5 11000 4490 3000 0 0>,
		<21 35 0 50 6 11000 4490 2500 0 0>,
		<21 35 0 50 7 11000 4490 2000 0 0>,
		<21 35 0 50 8 11000 4490 1500 0 0>,
		<21 35 0 50 9 11000 4500 1000 1 0>,
		<21 35 50 120 0 11000 4150 5000 0 0>,
		<21 35 50 120 1 11000 4150 4500 0 0>,
		<21 35 50 120 2 11000 4490 4250 0 0>,
		<21 35 50 120 3 11000 4490 4000 0 0>,
		<21 35 50 120 4 11000 4490 3500 0 0>,
		<21 35 50 120 5 11000 4490 3000 0 0>,
		<21 35 50 120 6 11000 4490 2500 0 0>,
		<21 35 50 120 7 11000 4490 2000 0 0>,
		<21 35 50 120 8 11000 4490 1500 0 0>,
		<21 35 50 120 9 11000 4500 1000 1 0>,
		<21 35 120 160 0 11000 4480 5000 0 0>,
		<21 35 120 160 1 11000 4490 4950 0 0>,
		<21 35 120 160 2 11000 4490 4500 0 0>,
		<21 35 120 160 3 11000 4490 4000 0 0>,
		<21 35 120 160 4 11000 4490 3500 0 0>,
		<21 35 120 160 5 11000 4490 3000 0 0>,
		<21 35 120 160 6 11000 4490 2500 0 0>,
		<21 35 120 160 7 11000 4490 2000 0 0>,
		<21 35 120 160 8 11000 4490 1500 0 0>,
		<21 35 120 160 9 11000 4500 1000 1 0>,
		<21 35 160 210 0 11000 4480 5000 0 0>,
		<21 35 160 210 1 11000 4490 4950 0 0>,
		<21 35 160 210 2 11000 4490 4500 0 0>,
		<21 35 160 210 3 11000 4490 4000 0 0>,
		<21 35 160 210 4 11000 4490 3500 0 0>,
		<21 35 160 210 5 11000 4490 3000 0 0>,
		<21 35 160 210 6 11000 4490 2500 0 0>,
		<21 35 160 210 7 11000 4490 2000 0 0>,
		<21 35 160 210 8 11000 4490 1500 0 0>,
		<21 35 160 210 9 11000 4500 1000 1 0>,
		<21 35 210 350 0 11000 4480 5000 0 0>,
		<21 35 210 350 1 11000 4490 4950 0 0>,
		<21 35 210 350 2 11000 4490 4500 0 0>,
		<21 35 210 350 3 11000 4490 4000 0 0>,
		<21 35 210 350 4 11000 4490 3500 0 0>,
		<21 35 210 350 5 11000 4490 3000 0 0>,
		<21 35 210 350 6 11000 4490 2500 0 0>,
		<21 35 210 350 7 11000 4490 2000 0 0>,
		<21 35 210 350 8 11000 4490 1500 0 0>,
		<21 35 210 350 9 11000 4500 1000 1 0>,
		<21 35 350 440 0 11000 4470 5000 0 0>,
		<21 35 350 440 1 11000 4470 4950 0 0>,
		<21 35 350 440 2 11000 4470 4500 0 0>,
		<21 35 350 440 3 11000 4470 4000 0 0>,
		<21 35 350 440 4 11000 4470 3500 0 0>,
		<21 35 350 440 5 11000 4470 3000 0 0>,
		<21 35 350 440 6 11000 4470 2500 0 0>,
		<21 35 350 440 7 11000 4470 2000 0 0>,
		<21 35 350 440 8 11000 4470 1500 0 0>,
		<21 35 350 440 9 11000 4480 1000 1 0>,
		<21 35 440 510 0 11000 4120 3250 0 0>,
		<21 35 440 510 1 11000 4120 3000 0 0>,
		<21 35 440 510 2 11000 4120 2500 0 0>,
		<21 35 440 510 3 11000 4120 2000 0 0>,
		<21 35 440 510 4 11000 4120 1500 0 0>,
		<21 35 440 510 5 11000 4130 1000 1 0>,
		<36 55 0 50 0 11000 4490 2000 0 0>,
		<36 55 0 50 1 11000 4490 1500 0 0>,
		<36 55 0 50 2 11000 4500 1000 1 0>,
		<36 55 50 120 0 11000 4490 2500 0 0>,
		<36 55 50 120 1 11000 4490 2000 0 0>,
		<36 55 50 120 2 11000 4490 1500 0 0>,
		<36 55 50 120 3 11000 4500 1000 1 0>,
		<36 55 120 160 0 11000 4490 4000 0 0>,
		<36 55 120 160 1 11000 4490 3500 0 0>,
		<36 55 120 160 2 11000 4490 3000 0 0>,
		<36 55 120 160 3 11000 4490 2500 0 0>,
		<36 55 120 160 4 11000 4490 2000 0 0>,
		<36 55 120 160 5 11000 4490 1500 0 0>,
		<36 55 120 160 6 11000 4500 1000 1 0>,
		<36 55 160 210 0 11000 4490 4000 0 0>,
		<36 55 160 210 1 11000 4490 3500 0 0>,
		<36 55 160 210 2 11000 4490 3000 0 0>,
		<36 55 160 210 3 11000 4490 2500 0 0>,
		<36 55 160 210 4 11000 4490 2000 0 0>,
		<36 55 160 210 5 11000 4490 1500 0 0>,
		<36 55 160 210 6 11000 4500 1000 1 0>,
		<36 55 210 350 0 11000 4480 5000 0 0>,
		<36 55 210 350 1 11000 4490 4950 0 0>,
		<36 55 210 350 2 11000 4490 4500 0 0>,
		<36 55 210 350 3 11000 4490 4000 0 0>,
		<36 55 210 350 4 11000 4490 3500 0 0>,
		<36 55 210 350 5 11000 4490 3000 0 0>,
		<36 55 210 350 6 11000 4490 2500 0 0>,
		<36 55 210 350 7 11000 4490 2000 0 0>,
		<36 55 210 350 8 11000 4490 1500 0 0>,
		<36 55 210 350 9 11000 4500 1000 1 0>,
		<36 55 350 440 0 11000 4470 5000 0 0>,
		<36 55 350 440 1 11000 4470 4950 0 0>,
		<36 55 350 440 2 11000 4470 4500 0 0>,
		<36 55 350 440 3 11000 4470 4000 0 0>,
		<36 55 350 440 4 11000 4470 3500 0 0>,
		<36 55 350 440 5 11000 4470 3000 0 0>,
		<36 55 350 440 6 11000 4470 2500 0 0>,
		<36 55 350 440 7 11000 4470 2000 0 0>,
		<36 55 350 440 8 11000 4470 1500 0 0>,
		<36 55 350 440 9 11000 4480 1000 1 0>,
		<36 55 440 510 0 11000 4120 3250 0 0>,
		<36 55 440 510 1 11000 4120 3000 0 0>,
		<36 55 440 510 2 11000 4120 2500 0 0>,
		<36 55 440 510 3 11000 4120 2000 0 0>,
		<36 55 440 510 4 11000 4120 1500 0 0>,
		<36 55 440 510 5 11000 4130 1000 1 0>,
		<56 75 0 50 0 11000 4490 1500 0 0>,
		<56 75 0 50 1 11000 4500 1000 1 0>,
		<56 75 50 120 0 11000 4490 1500 0 0>,
		<56 75 50 120 1 11000 4500 1000 1 0>,
		<56 75 120 160 0 11000 4490 2500 0 0>,
		<56 75 120 160 1 11000 4490 2000 0 0>,
		<56 75 120 160 2 11000 4490 1500 0 0>,
		<56 75 120 160 3 11000 4500 1000 1 0>,
		<56 75 160 210 0 11000 4490 3000 0 0>,
		<56 75 160 210 1 11000 4490 2500 0 0>,
		<56 75 160 210 2 11000 4490 2000 0 0>,
		<56 75 160 210 3 11000 4490 1500 0 0>,
		<56 75 160 210 4 11000 4500 1000 1 0>,
		<56 75 210 350 0 11000 4490 3000 0 0>,
		<56 75 210 350 1 11000 4490 2500 0 0>,
		<56 75 210 350 2 11000 4490 2000 0 0>,
		<56 75 210 350 3 11000 4490 1500 0 0>,
		<56 75 210 350 4 11000 4500 1000 1 0>,
		<56 75 350 440 0 11000 4470 3500 0 0>,
		<56 75 350 440 1 11000 4470 3000 0 0>,
		<56 75 350 440 2 11000 4470 2500 0 0>,
		<56 75 350 440 3 11000 4470 2000 0 0>,
		<56 75 350 440 4 11000 4470 1500 0 0>,
		<56 75 350 440 5 11000 4480 1000 1 0>,
		<56 75 440 510 0 11000 4130 1000 1 0>,
		<76 85 0 50 0 11000 4500 1000 1 0>,
		<76 85 50 120 0 11000 4490 1500 0 0>,
		<76 85 50 120 1 11000 4500 1000 1 0>,
		<76 85 120 160 0 11000 4490 2000 0 0>,
		<76 85 120 160 1 11000 4490 1500 0 0>,
		<76 85 120 160 2 11000 4500 1000 1 0>,
		<76 85 160 210 0 11000 4490 2500 0 0>,
		<76 85 160 210 1 11000 4490 2000 0 0>,
		<76 85 160 210 2 11000 4490 1500 0 0>,
		<76 85 160 210 3 11000 4500 1000 1 0>,
		<76 85 210 350 0 11000 4490 3000 0 0>,
		<76 85 210 350 1 11000 4490 2500 0 0>,
		<76 85 210 350 2 11000 4490 2000 0 0>,
		<76 85 210 350 3 11000 4490 1500 0 0>,
		<76 85 210 350 4 11000 4500 1000 1 0>,
		<76 85 350 440 0 11000 4470 3000 0 0>,
		<76 85 350 440 1 11000 4470 2500 0 0>,
		<76 85 350 440 2 11000 4470 2000 0 0>,
		<76 85 350 440 3 11000 4470 1500 0 0>,
		<76 85 350 440 4 11000 4480 1000 1 0>,
		<76 85 440 510 0 11000 4130 1000 1 0>,
		<86 90 0 50 0 11000 4500 1000 1 0>,
		<86 90 50 120 0 11000 4500 1000 1 0>,
		<86 90 120 160 0 11000 4490 1500 0 0>,
		<86 90 120 160 1 11000 4500 1000 1 0>,
		<86 90 160 210 0 11000 4490 2000 0 0>,
		<86 90 160 210 1 11000 4490 1500 0 0>,
		<86 90 160 210 2 11000 4500 1000 1 0>,
		<86 90 210 350 0 11000 4490 2000 0 0>,
		<86 90 210 350 1 11000 4490 1500 0 0>,
		<86 90 210 350 2 11000 4500 1000 1 0>,
		<86 90 350 440 0 11000 4470 2500 0 0>,
		<86 90 350 440 1 11000 4470 2000 0 0>,
		<86 90 350 440 2 11000 4470 1500 0 0>,
		<86 90 350 440 3 11000 4480 1000 1 0>,
		<86 90 440 510 0 11000 4130 1000 1 0>;
};

&fastchg_pps {
	oplus,low-current-full =
		<0 50 660 4510 0>,
		<0 50 635 4500 0>,
		<0 50 610 4490 0>,
		<0 50 585 4480 0>,
		<0 50 560 4470 1>,
		<50 120 660 4510 0>,
		<50 120 625 4505 0>,
		<50 120 590 4490 0>,
		<50 120 555 4480 0>,
		<50 120 520 4470 1>,
		<120 160 1784 4529 0>,
		<120 160 1584 4521 0>,
		<120 160 1434 4496 0>,
		<120 160 1284 4496 0>,
		<120 160 1000 4475 1>,
		<160 210 3328 4542 0>,
		<160 210 3128 4536 0>,
		<160 210 2428 4513 0>,
		<160 210 1728 4503 0>,
		<160 210 1000 4481 1>,
		<210 380 3328 4542 0>,
		<210 380 3128 4536 0>,
		<210 380 2428 4513 0>,
		<210 380 1728 4503 0>,
		<210 380 1000 4481 1>,
		<380 440 6148 4543 0>,
		<380 440 5948 4538 0>,
		<380 440 4348 4507 0>,
		<380 440 2748 4475 0>,
		<380 440 1000 4451 1>;
};

&fastchg_ufcs {
	oplus,charge-curve =
		<0 20 0 50 0 11000 4490 4000 0 0>,
		<0 20 0 50 1 11000 4490 3500 0 0>,
		<0 20 0 50 2 11000 4490 3000 0 0>,
		<0 20 0 50 3 11000 4490 2500 0 0>,
		<0 20 0 50 4 11000 4490 2000 0 0>,
		<0 20 0 50 5 11000 4490 1500 0 0>,
		<0 20 0 50 6 11000 4500 1000 1 0>,
		<0 20 50 120 0 11000 4490 4000 0 0>,
		<0 20 50 120 1 11000 4490 3500 0 0>,
		<0 20 50 120 2 11000 4490 3000 0 0>,
		<0 20 50 120 3 11000 4490 2500 0 0>,
		<0 20 50 120 4 11000 4490 2000 0 0>,
		<0 20 50 120 5 11000 4490 1500 0 0>,
		<0 20 50 120 6 11000 4500 1000 1 0>,
		<0 20 120 160 0 11000 4490 4000 0 0>,
		<0 20 120 160 1 11000 4490 3500 0 0>,
		<0 20 120 160 2 11000 4490 3000 0 0>,
		<0 20 120 160 3 11000 4490 2500 0 0>,
		<0 20 120 160 4 11000 4490 2000 0 0>,
		<0 20 120 160 5 11000 4490 1500 0 0>,
		<0 20 120 160 6 11000 4500 1000 1 0>,
		<0 20 160 210 0 11000 4490 4000 0 0>,
		<0 20 160 210 1 11000 4490 3500 0 0>,
		<0 20 160 210 2 11000 4490 3000 0 0>,
		<0 20 160 210 3 11000 4490 2500 0 0>,
		<0 20 160 210 4 11000 4490 2000 0 0>,
		<0 20 160 210 5 11000 4490 1500 0 0>,
		<0 20 160 210 6 11000 4500 1000 1 0>,
		<0 20 210 350 0 11000 4490 4000 0 0>,
		<0 20 210 350 1 11000 4490 3500 0 0>,
		<0 20 210 350 2 11000 4490 3000 0 0>,
		<0 20 210 350 3 11000 4490 2500 0 0>,
		<0 20 210 350 4 11000 4490 2000 0 0>,
		<0 20 210 350 5 11000 4490 1500 0 0>,
		<0 20 210 350 6 11000 4500 1000 1 0>,
		<0 20 350 440 0 11000 4470 4000 0 0>,
		<0 20 350 440 1 11000 4470 3500 0 0>,
		<0 20 350 440 2 11000 4470 3000 0 0>,
		<0 20 350 440 3 11000 4470 2500 0 0>,
		<0 20 350 440 4 11000 4470 2000 0 0>,
		<0 20 350 440 5 11000 4470 1500 0 0>,
		<0 20 350 440 6 11000 4480 1000 1 0>,
		<0 20 440 510 0 11000 4120 3250 0 0>,
		<0 20 440 510 1 11000 4120 3000 0 0>,
		<0 20 440 510 2 11000 4120 2500 0 0>,
		<0 20 440 510 3 11000 4120 2000 0 0>,
		<0 20 440 510 4 11000 4120 1500 0 0>,
		<0 20 440 510 5 11000 4130 1000 1 0>,
		<21 35 0 50 0 11000 4490 4000 0 0>,
		<21 35 0 50 1 11000 4490 3500 0 0>,
		<21 35 0 50 2 11000 4490 3000 0 0>,
		<21 35 0 50 3 11000 4490 2500 0 0>,
		<21 35 0 50 4 11000 4490 2000 0 0>,
		<21 35 0 50 5 11000 4490 1500 0 0>,
		<21 35 0 50 6 11000 4500 1000 1 0>,
		<21 35 50 120 0 11000 4490 4000 0 0>,
		<21 35 50 120 1 11000 4490 3500 0 0>,
		<21 35 50 120 2 11000 4490 3000 0 0>,
		<21 35 50 120 3 11000 4490 2500 0 0>,
		<21 35 50 120 4 11000 4490 2000 0 0>,
		<21 35 50 120 5 11000 4490 1500 0 0>,
		<21 35 50 120 6 11000 4500 1000 1 0>,
		<21 35 120 160 0 11000 4490 4000 0 0>,
		<21 35 120 160 1 11000 4490 3500 0 0>,
		<21 35 120 160 2 11000 4490 3000 0 0>,
		<21 35 120 160 3 11000 4490 2500 0 0>,
		<21 35 120 160 4 11000 4490 2000 0 0>,
		<21 35 120 160 5 11000 4490 1500 0 0>,
		<21 35 120 160 6 11000 4500 1000 1 0>,
		<21 35 160 210 0 11000 4490 4000 0 0>,
		<21 35 160 210 1 11000 4490 3500 0 0>,
		<21 35 160 210 2 11000 4490 3000 0 0>,
		<21 35 160 210 3 11000 4490 2500 0 0>,
		<21 35 160 210 4 11000 4490 2000 0 0>,
		<21 35 160 210 5 11000 4490 1500 0 0>,
		<21 35 160 210 6 11000 4500 1000 1 0>,
		<21 35 210 350 0 11000 4490 4000 0 0>,
		<21 35 210 350 1 11000 4490 3500 0 0>,
		<21 35 210 350 2 11000 4490 3000 0 0>,
		<21 35 210 350 3 11000 4490 2500 0 0>,
		<21 35 210 350 4 11000 4490 2000 0 0>,
		<21 35 210 350 5 11000 4490 1500 0 0>,
		<21 35 210 350 6 11000 4500 1000 1 0>,
		<21 35 350 440 0 11000 4470 4000 0 0>,
		<21 35 350 440 1 11000 4470 3500 0 0>,
		<21 35 350 440 2 11000 4470 3000 0 0>,
		<21 35 350 440 3 11000 4470 2500 0 0>,
		<21 35 350 440 4 11000 4470 2000 0 0>,
		<21 35 350 440 5 11000 4470 1500 0 0>,
		<21 35 350 440 6 11000 4480 1000 1 0>,
		<21 35 440 510 0 11000 4120 3250 0 0>,
		<21 35 440 510 1 11000 4120 3000 0 0>,
		<21 35 440 510 2 11000 4120 2500 0 0>,
		<21 35 440 510 3 11000 4120 2000 0 0>,
		<21 35 440 510 4 11000 4120 1500 0 0>,
		<21 35 440 510 5 11000 4130 1000 1 0>,
		<36 55 0 50 0 11000 4490 2000 0 0>,
		<36 55 0 50 1 11000 4490 1500 0 0>,
		<36 55 0 50 2 11000 4500 1000 1 0>,
		<36 55 50 120 0 11000 4490 2500 0 0>,
		<36 55 50 120 1 11000 4490 2000 0 0>,
		<36 55 50 120 2 11000 4490 1500 0 0>,
		<36 55 50 120 3 11000 4500 1000 1 0>,
		<36 55 120 160 0 11000 4490 4000 0 0>,
		<36 55 120 160 1 11000 4490 3500 0 0>,
		<36 55 120 160 2 11000 4490 3000 0 0>,
		<36 55 120 160 3 11000 4490 2500 0 0>,
		<36 55 120 160 4 11000 4490 2000 0 0>,
		<36 55 120 160 5 11000 4490 1500 0 0>,
		<36 55 120 160 6 11000 4500 1000 1 0>,
		<36 55 160 210 0 11000 4490 4000 0 0>,
		<36 55 160 210 1 11000 4490 3500 0 0>,
		<36 55 160 210 2 11000 4490 3000 0 0>,
		<36 55 160 210 3 11000 4490 2500 0 0>,
		<36 55 160 210 4 11000 4490 2000 0 0>,
		<36 55 160 210 5 11000 4490 1500 0 0>,
		<36 55 160 210 6 11000 4500 1000 1 0>,
		<36 55 210 350 0 11000 4490 4000 0 0>,
		<36 55 210 350 1 11000 4490 3500 0 0>,
		<36 55 210 350 2 11000 4490 3000 0 0>,
		<36 55 210 350 3 11000 4490 2500 0 0>,
		<36 55 210 350 4 11000 4490 2000 0 0>,
		<36 55 210 350 5 11000 4490 1500 0 0>,
		<36 55 210 350 6 11000 4500 1000 1 0>,
		<36 55 350 440 0 11000 4470 4000 0 0>,
		<36 55 350 440 1 11000 4470 3500 0 0>,
		<36 55 350 440 2 11000 4470 3000 0 0>,
		<36 55 350 440 3 11000 4470 2500 0 0>,
		<36 55 350 440 4 11000 4470 2000 0 0>,
		<36 55 350 440 5 11000 4470 1500 0 0>,
		<36 55 350 440 6 11000 4480 1000 1 0>,
		<36 55 440 510 0 11000 4120 3250 0 0>,
		<36 55 440 510 1 11000 4120 3000 0 0>,
		<36 55 440 510 2 11000 4120 2500 0 0>,
		<36 55 440 510 3 11000 4120 2000 0 0>,
		<36 55 440 510 4 11000 4120 1500 0 0>,
		<36 55 440 510 5 11000 4130 1000 1 0>,
		<56 75 0 50 0 11000 4490 1500 0 0>,
		<56 75 0 50 1 11000 4500 1000 1 0>,
		<56 75 50 120 0 11000 4490 1500 0 0>,
		<56 75 50 120 1 11000 4500 1000 1 0>,
		<56 75 120 160 0 11000 4490 2500 0 0>,
		<56 75 120 160 1 11000 4490 2000 0 0>,
		<56 75 120 160 2 11000 4490 1500 0 0>,
		<56 75 120 160 3 11000 4500 1000 1 0>,
		<56 75 160 210 0 11000 4490 3000 0 0>,
		<56 75 160 210 1 11000 4490 2500 0 0>,
		<56 75 160 210 2 11000 4490 2000 0 0>,
		<56 75 160 210 3 11000 4490 1500 0 0>,
		<56 75 160 210 4 11000 4500 1000 1 0>,
		<56 75 210 350 0 11000 4490 3000 0 0>,
		<56 75 210 350 1 11000 4490 2500 0 0>,
		<56 75 210 350 2 11000 4490 2000 0 0>,
		<56 75 210 350 3 11000 4490 1500 0 0>,
		<56 75 210 350 4 11000 4500 1000 1 0>,
		<56 75 350 440 0 11000 4470 3500 0 0>,
		<56 75 350 440 1 11000 4470 3000 0 0>,
		<56 75 350 440 2 11000 4470 2500 0 0>,
		<56 75 350 440 3 11000 4470 2000 0 0>,
		<56 75 350 440 4 11000 4470 1500 0 0>,
		<56 75 350 440 5 11000 4480 1000 1 0>,
		<56 75 440 510 0 11000 4130 1000 1 0>,
		<76 85 0 50 0 11000 4500 1000 1 0>,
		<76 85 50 120 0 11000 4490 1500 0 0>,
		<76 85 50 120 1 11000 4500 1000 1 0>,
		<76 85 120 160 0 11000 4490 2000 0 0>,
		<76 85 120 160 1 11000 4490 1500 0 0>,
		<76 85 120 160 2 11000 4500 1000 1 0>,
		<76 85 160 210 0 11000 4490 2500 0 0>,
		<76 85 160 210 1 11000 4490 2000 0 0>,
		<76 85 160 210 2 11000 4490 1500 0 0>,
		<76 85 160 210 3 11000 4500 1000 1 0>,
		<76 85 210 350 0 11000 4490 3000 0 0>,
		<76 85 210 350 1 11000 4490 2500 0 0>,
		<76 85 210 350 2 11000 4490 2000 0 0>,
		<76 85 210 350 3 11000 4490 1500 0 0>,
		<76 85 210 350 4 11000 4500 1000 1 0>,
		<76 85 350 440 0 11000 4470 3000 0 0>,
		<76 85 350 440 1 11000 4470 2500 0 0>,
		<76 85 350 440 2 11000 4470 2000 0 0>,
		<76 85 350 440 3 11000 4470 1500 0 0>,
		<76 85 350 440 4 11000 4480 1000 1 0>,
		<76 85 440 510 0 11000 4130 1000 1 0>,
		<86 90 0 50 0 11000 4500 1000 1 0>,
		<86 90 50 120 0 11000 4500 1000 1 0>,
		<86 90 120 160 0 11000 4490 1500 0 0>,
		<86 90 120 160 1 11000 4500 1000 1 0>,
		<86 90 160 210 0 11000 4490 2000 0 0>,
		<86 90 160 210 1 11000 4490 1500 0 0>,
		<86 90 160 210 2 11000 4500 1000 1 0>,
		<86 90 210 350 0 11000 4490 2000 0 0>,
		<86 90 210 350 1 11000 4490 1500 0 0>,
		<86 90 210 350 2 11000 4500 1000 1 0>,
		<86 90 350 440 0 11000 4470 2500 0 0>,
		<86 90 350 440 1 11000 4470 2000 0 0>,
		<86 90 350 440 2 11000 4470 1500 0 0>,
		<86 90 350 440 3 11000 4480 1000 1 0>,
		<86 90 440 510 0 11000 4130 1000 1 0>;
};

&fastchg_ufcs {
	oplus,low-current-full =
		<0 50 660 4510 0>,
		<0 50 635 4500 0>,
		<0 50 610 4490 0>,
		<0 50 585 4480 0>,
		<0 50 560 4470 1>,
		<50 120 660 4510 0>,
		<50 120 625 4505 0>,
		<50 120 590 4490 0>,
		<50 120 555 4480 0>,
		<50 120 520 4470 1>,
		<120 160 1784 4529 0>,
		<120 160 1584 4521 0>,
		<120 160 1434 4496 0>,
		<120 160 1284 4496 0>,
		<120 160 1000 4475 1>,
		<160 210 3328 4542 0>,
		<160 210 3128 4536 0>,
		<160 210 2428 4513 0>,
		<160 210 1728 4503 0>,
		<160 210 1000 4481 1>,
		<210 380 3328 4542 0>,
		<210 380 3128 4536 0>,
		<210 380 2428 4513 0>,
		<210 380 1728 4503 0>,
		<210 380 1000 4481 1>,
		<380 440 6148 4543 0>,
		<380 440 5948 4538 0>,
		<380 440 4348 4507 0>,
		<380 440 2748 4475 0>,
		<380 440 1000 4451 1>;
};

&fastchg_vooc {
	oplus,charge-curve =
		<0 20 0 50 0 0 4150 6200 0 0>,
		<0 20 0 50 1 0 4150 6000 0 0>,
		<0 20 0 50 2 0 4150 5500 0 0>,
		<0 20 0 50 3 0 4150 5000 0 0>,
		<0 20 0 50 4 0 4150 4500 0 0>,
		<0 20 0 50 5 0 4500 4200 0 0>,
		<0 20 0 50 6 0 4500 4000 0 0>,
		<0 20 0 50 7 0 4500 3500 0 0>,
		<0 20 0 50 8 0 4500 3000 0 0>,
		<0 20 0 50 9 0 4500 2500 0 0>,
		<0 20 0 50 10 0 4500 2000 0 0>,
		<0 20 0 50 11 0 4500 1500 0 0>,
		<0 20 0 50 12 0 4510 1000 1 0>,
		<0 20 50 120 0 0 4150 6200 0 0>,
		<0 20 50 120 1 0 4150 6000 0 0>,
		<0 20 50 120 2 0 4150 5500 0 0>,
		<0 20 50 120 3 0 4150 5000 0 0>,
		<0 20 50 120 4 0 4150 4500 0 0>,
		<0 20 50 120 5 0 4500 4200 0 0>,
		<0 20 50 120 6 0 4500 4000 0 0>,
		<0 20 50 120 7 0 4500 3500 0 0>,
		<0 20 50 120 8 0 4500 3000 0 0>,
		<0 20 50 120 9 0 4500 2500 0 0>,
		<0 20 50 120 10 0 4500 2000 0 0>,
		<0 20 50 120 11 0 4500 1500 0 0>,
		<0 20 50 120 12 0 4510 1000 1 0>,
		<0 20 120 160 0 0 4480 7300 0 0>,
		<0 20 120 160 1 0 4480 6000 0 0>,
		<0 20 120 160 2 0 4480 5000 0 0>,
		<0 20 120 160 3 0 4540 4900 0 0>,
		<0 20 120 160 4 0 4540 4500 0 0>,
		<0 20 120 160 5 0 4540 4000 0 0>,
		<0 20 120 160 6 0 4540 3500 0 0>,
		<0 20 120 160 7 0 4540 3000 0 0>,
		<0 20 120 160 8 0 4540 2500 0 0>,
		<0 20 120 160 9 0 4540 2000 0 0>,
		<0 20 120 160 10 0 4540 1500 0 0>,
		<0 20 120 160 11 0 4550 1100 1 0>,
		<0 20 160 210 0 0 4480 7300 0 0>,
		<0 20 160 210 1 0 4480 6000 0 0>,
		<0 20 160 210 2 0 4480 5000 0 0>,
		<0 20 160 210 3 0 4540 4900 0 0>,
		<0 20 160 210 4 0 4540 4500 0 0>,
		<0 20 160 210 5 0 4540 4000 0 0>,
		<0 20 160 210 6 0 4540 3500 0 0>,
		<0 20 160 210 7 0 4540 3000 0 0>,
		<0 20 160 210 8 0 4540 2500 0 0>,
		<0 20 160 210 9 0 4540 2000 0 0>,
		<0 20 160 210 10 0 4550 1800 1 0>,
		<0 20 210 350 0 0 4480 7300 0 0>,
		<0 20 210 350 1 0 4480 6000 0 0>,
		<0 20 210 350 2 0 4480 5000 0 0>,
		<0 20 210 350 3 0 4540 4900 0 0>,
		<0 20 210 350 4 0 4540 4500 0 0>,
		<0 20 210 350 5 0 4540 4000 0 0>,
		<0 20 210 350 6 0 4540 3500 0 0>,
		<0 20 210 350 7 0 4540 3000 0 0>,
		<0 20 210 350 8 0 4540 2500 0 0>,
		<0 20 210 350 9 0 4540 2000 0 0>,
		<0 20 210 350 10 0 4550 1800 1 0>,
		<0 20 350 440 0 0 4480 7300 0 0>,
		<0 20 350 440 1 0 4480 6000 0 0>,
		<0 20 350 440 2 0 4480 5000 0 0>,
		<0 20 350 440 3 0 4540 4900 0 0>,
		<0 20 350 440 4 0 4540 4500 0 0>,
		<0 20 350 440 5 0 4540 4000 0 0>,
		<0 20 350 440 6 0 4540 3500 0 0>,
		<0 20 350 440 7 0 4550 3200 0 0>,
		<0 20 350 440 8 0 4539 3000 0 0>,
		<0 20 350 440 9 0 4523 2500 0 0>,
		<0 20 350 440 10 0 4507 2000 0 0>,
		<0 20 350 440 11 0 4491 1500 0 0>,
		<0 20 350 440 12 0 4475 1000 1 0>,
		<0 20 440 510 0 0 4120 3300 0 0>,
		<0 20 440 510 1 0 4120 3000 0 0>,
		<0 20 440 510 2 0 4120 2500 0 0>,
		<0 20 440 510 3 0 4120 2000 0 0>,
		<0 20 440 510 4 0 4120 1500 0 0>,
		<0 20 440 510 5 0 4130 1000 1 0>,
		<21 35 0 50 0 0 4150 6200 0 0>,
		<21 35 0 50 1 0 4150 6000 0 0>,
		<21 35 0 50 2 0 4150 5500 0 0>,
		<21 35 0 50 3 0 4150 5000 0 0>,
		<21 35 0 50 4 0 4150 4500 0 0>,
		<21 35 0 50 5 0 4500 4200 0 0>,
		<21 35 0 50 6 0 4500 4000 0 0>,
		<21 35 0 50 7 0 4500 3500 0 0>,
		<21 35 0 50 8 0 4500 3000 0 0>,
		<21 35 0 50 9 0 4500 2500 0 0>,
		<21 35 0 50 10 0 4500 2000 0 0>,
		<21 35 0 50 11 0 4500 1500 0 0>,
		<21 35 0 50 12 0 4510 1000 1 0>,
		<21 35 50 120 0 0 4150 6200 0 0>,
		<21 35 50 120 1 0 4150 6000 0 0>,
		<21 35 50 120 2 0 4150 5500 0 0>,
		<21 35 50 120 3 0 4150 5000 0 0>,
		<21 35 50 120 4 0 4150 4500 0 0>,
		<21 35 50 120 5 0 4500 4200 0 0>,
		<21 35 50 120 6 0 4500 4000 0 0>,
		<21 35 50 120 7 0 4500 3500 0 0>,
		<21 35 50 120 8 0 4500 3000 0 0>,
		<21 35 50 120 9 0 4500 2500 0 0>,
		<21 35 50 120 10 0 4500 2000 0 0>,
		<21 35 50 120 11 0 4500 1500 0 0>,
		<21 35 50 120 12 0 4510 1000 1 0>,
		<21 35 120 160 0 0 4480 7300 0 0>,
		<21 35 120 160 1 0 4480 6000 0 0>,
		<21 35 120 160 2 0 4480 5000 0 0>,
		<21 35 120 160 3 0 4540 4900 0 0>,
		<21 35 120 160 4 0 4540 4500 0 0>,
		<21 35 120 160 5 0 4540 4000 0 0>,
		<21 35 120 160 6 0 4540 3500 0 0>,
		<21 35 120 160 7 0 4540 3000 0 0>,
		<21 35 120 160 8 0 4540 2500 0 0>,
		<21 35 120 160 9 0 4540 2000 0 0>,
		<21 35 120 160 10 0 4540 1500 0 0>,
		<21 35 120 160 11 0 4550 1100 1 0>,
		<21 35 160 210 0 0 4480 7300 0 0>,
		<21 35 160 210 1 0 4480 6000 0 0>,
		<21 35 160 210 2 0 4480 5000 0 0>,
		<21 35 160 210 3 0 4540 4900 0 0>,
		<21 35 160 210 4 0 4540 4500 0 0>,
		<21 35 160 210 5 0 4540 4000 0 0>,
		<21 35 160 210 6 0 4540 3500 0 0>,
		<21 35 160 210 7 0 4540 3000 0 0>,
		<21 35 160 210 8 0 4540 2500 0 0>,
		<21 35 160 210 9 0 4540 2000 0 0>,
		<21 35 160 210 10 0 4550 1800 1 0>,
		<21 35 210 350 0 0 4480 7300 0 0>,
		<21 35 210 350 1 0 4480 6000 0 0>,
		<21 35 210 350 2 0 4480 5000 0 0>,
		<21 35 210 350 3 0 4540 4900 0 0>,
		<21 35 210 350 4 0 4540 4500 0 0>,
		<21 35 210 350 5 0 4540 4000 0 0>,
		<21 35 210 350 6 0 4540 3500 0 0>,
		<21 35 210 350 7 0 4540 3000 0 0>,
		<21 35 210 350 8 0 4540 2500 0 0>,
		<21 35 210 350 9 0 4540 2000 0 0>,
		<21 35 210 350 10 0 4550 1800 1 0>,
		<21 35 350 440 0 0 4480 7300 0 0>,
		<21 35 350 440 1 0 4480 6000 0 0>,
		<21 35 350 440 2 0 4480 5000 0 0>,
		<21 35 350 440 3 0 4540 4900 0 0>,
		<21 35 350 440 4 0 4540 4500 0 0>,
		<21 35 350 440 5 0 4540 4000 0 0>,
		<21 35 350 440 6 0 4540 3500 0 0>,
		<21 35 350 440 7 0 4550 3200 0 0>,
		<21 35 350 440 8 0 4539 3000 0 0>,
		<21 35 350 440 9 0 4523 2500 0 0>,
		<21 35 350 440 10 0 4507 2000 0 0>,
		<21 35 350 440 11 0 4491 1500 0 0>,
		<21 35 350 440 12 0 4475 1000 1 0>,
		<21 35 440 510 0 0 4120 3300 0 0>,
		<21 35 440 510 1 0 4120 3000 0 0>,
		<21 35 440 510 2 0 4120 2500 0 0>,
		<21 35 440 510 3 0 4120 2000 0 0>,
		<21 35 440 510 4 0 4120 1500 0 0>,
		<21 35 440 510 5 0 4130 1000 1 0>,
		<36 55 0 50 0 0 4500 2000 0 0>,
		<36 55 0 50 1 0 4500 1500 0 0>,
		<36 55 0 50 2 0 4510 1000 1 0>,
		<36 55 50 120 0 0 4500 2500 0 0>,
		<36 55 50 120 1 0 4500 2000 0 0>,
		<36 55 50 120 2 0 4500 1500 0 0>,
		<36 55 50 120 3 0 4510 1000 1 0>,
		<36 55 120 160 0 0 4540 4000 0 0>,
		<36 55 120 160 1 0 4540 3500 0 0>,
		<36 55 120 160 2 0 4540 3000 0 0>,
		<36 55 120 160 3 0 4540 2500 0 0>,
		<36 55 120 160 4 0 4540 2000 0 0>,
		<36 55 120 160 5 0 4540 1500 0 0>,
		<36 55 120 160 6 0 4550 1100 1 0>,
		<36 55 160 210 0 0 4540 4000 0 0>,
		<36 55 160 210 1 0 4540 3500 0 0>,
		<36 55 160 210 2 0 4540 3000 0 0>,
		<36 55 160 210 3 0 4540 2500 0 0>,
		<36 55 160 210 4 0 4540 2000 0 0>,
		<36 55 160 210 5 0 4550 1800 1 0>,
		<36 55 210 350 0 0 4480 7300 0 0>,
		<36 55 210 350 1 0 4480 6000 0 0>,
		<36 55 210 350 2 0 4480 5000 0 0>,
		<36 55 210 350 3 0 4540 4900 0 0>,
		<36 55 210 350 4 0 4540 4500 0 0>,
		<36 55 210 350 5 0 4540 4000 0 0>,
		<36 55 210 350 6 0 4540 3500 0 0>,
		<36 55 210 350 7 0 4540 3000 0 0>,
		<36 55 210 350 8 0 4540 2500 0 0>,
		<36 55 210 350 9 0 4540 2000 0 0>,
		<36 55 210 350 10 0 4550 1800 1 0>,
		<36 55 350 440 0 0 4480 7300 0 0>,
		<36 55 350 440 1 0 4480 6000 0 0>,
		<36 55 350 440 2 0 4480 5000 0 0>,
		<36 55 350 440 3 0 4540 4900 0 0>,
		<36 55 350 440 4 0 4540 4500 0 0>,
		<36 55 350 440 5 0 4540 4000 0 0>,
		<36 55 350 440 6 0 4540 3500 0 0>,
		<36 55 350 440 7 0 4550 3200 0 0>,
		<36 55 350 440 8 0 4539 3000 0 0>,
		<36 55 350 440 9 0 4523 2500 0 0>,
		<36 55 350 440 10 0 4507 2000 0 0>,
		<36 55 350 440 11 0 4491 1500 0 0>,
		<36 55 350 440 12 0 4475 1000 1 0>,
		<36 55 440 510 0 0 4120 3300 0 0>,
		<36 55 440 510 1 0 4120 3000 0 0>,
		<36 55 440 510 2 0 4120 2500 0 0>,
		<36 55 440 510 3 0 4120 2000 0 0>,
		<36 55 440 510 4 0 4120 1500 0 0>,
		<36 55 440 510 5 0 4130 1000 1 0>,
		<56 75 0 50 0 0 4500 1500 0 0>,
		<56 75 0 50 1 0 4510 1000 1 0>,
		<56 75 50 120 0 0 4500 1500 0 0>,
		<56 75 50 120 1 0 4510 1000 1 0>,
		<56 75 120 160 0 0 4540 2500 0 0>,
		<56 75 120 160 1 0 4540 2000 0 0>,
		<56 75 120 160 2 0 4540 1500 0 0>,
		<56 75 120 160 3 0 4550 1100 1 0>,
		<56 75 160 210 0 0 4540 3000 0 0>,
		<56 75 160 210 1 0 4540 2500 0 0>,
		<56 75 160 210 2 0 4540 2000 0 0>,
		<56 75 160 210 3 0 4550 1800 1 0>,
		<56 75 210 350 0 0 4540 3000 0 0>,
		<56 75 210 350 1 0 4540 2500 0 0>,
		<56 75 210 350 2 0 4540 2000 0 0>,
		<56 75 210 350 3 0 4550 1800 1 0>,
		<56 75 350 440 0 0 4540 3500 0 0>,
		<56 75 350 440 1 0 4550 3200 0 0>,
		<56 75 350 440 2 0 4539 3000 0 0>,
		<56 75 350 440 3 0 4523 2500 0 0>,
		<56 75 350 440 4 0 4507 2000 0 0>,
		<56 75 350 440 5 0 4491 1500 0 0>,
		<56 75 350 440 6 0 4475 1000 1 0>,
		<56 75 440 510 0 0 4130 1000 1 0>,
		<76 85 0 50 0 0 4510 1000 1 0>,
		<76 85 50 120 0 0 4500 1500 0 0>,
		<76 85 50 120 1 0 4510 1000 1 0>,
		<76 85 120 160 0 0 4540 2000 0 0>,
		<76 85 120 160 1 0 4540 1500 0 0>,
		<76 85 120 160 2 0 4550 1100 1 0>,
		<76 85 160 210 0 0 4540 2500 0 0>,
		<76 85 160 210 1 0 4540 2000 0 0>,
		<76 85 160 210 2 0 4550 1800 1 0>,
		<76 85 210 350 0 0 4540 3000 0 0>,
		<76 85 210 350 1 0 4540 2500 0 0>,
		<76 85 210 350 2 0 4540 2000 0 0>,
		<76 85 210 350 3 0 4550 1800 1 0>,
		<76 85 350 440 0 0 4550 3200 0 0>,
		<76 85 350 440 1 0 4539 3000 0 0>,
		<76 85 350 440 2 0 4523 2500 0 0>,
		<76 85 350 440 3 0 4507 2000 0 0>,
		<76 85 350 440 4 0 4491 1500 0 0>,
		<76 85 350 440 5 0 4475 1000 1 0>,
		<76 85 440 510 0 0 4130 1000 1 0>,
		<86 90 0 50 0 0 4510 1000 1 0>,
		<86 90 50 120 0 0 4510 1000 1 0>,
		<86 90 120 160 0 0 4540 1500 0 0>,
		<86 90 120 160 1 0 4550 1100 1 0>,
		<86 90 160 210 0 0 4540 2000 0 0>,
		<86 90 160 210 1 0 4550 1800 1 0>,
		<86 90 210 350 0 0 4540 2000 0 0>,
		<86 90 210 350 1 0 4550 1800 1 0>,
		<86 90 350 440 0 0 4550 3200 0 0>,
		<86 90 350 440 1 0 4539 3000 0 0>,
		<86 90 350 440 2 0 4523 2500 0 0>,
		<86 90 350 440 3 0 4507 2000 0 0>,
		<86 90 350 440 4 0 4491 1500 0 0>,
		<86 90 350 440 5 0 4475 1000 1 0>,
		<86 90 440 510 0 0 4130 1000 1 0>;
};

&fastchg_vooc {
	oplus,low-current-full =
		<0 50 660 4510 0>,
		<0 50 635 4500 0>,
		<0 50 610 4490 0>,
		<0 50 585 4480 0>,
		<0 50 560 4470 1>,
		<50 120 660 4510 0>,
		<50 120 625 4505 0>,
		<50 120 590 4490 0>,
		<50 120 555 4480 0>,
		<50 120 520 4470 1>,
		<120 160 1784 4529 0>,
		<120 160 1584 4521 0>,
		<120 160 1434 4496 0>,
		<120 160 1284 4496 0>,
		<120 160 1000 4475 1>,
		<160 210 3328 4542 0>,
		<160 210 3128 4536 0>,
		<160 210 2428 4513 0>,
		<160 210 1728 4503 0>,
		<160 210 1000 4481 1>,
		<210 380 3328 4542 0>,
		<210 380 3128 4536 0>,
		<210 380 2428 4513 0>,
		<210 380 1728 4503 0>,
		<210 380 1000 4481 1>,
		<380 440 6148 4543 0>,
		<380 440 5948 4538 0>,
		<380 440 4348 4507 0>,
		<380 440 2748 4475 0>,
		<380 440 1000 4451 1>;
};

&fastchg_vooc_bypass {
	oplus,charge-curve =
		<0 20 0 50 0 0 4500 6000 0 0>,
		<0 20 0 50 1 0 4500 5000 0 0>,
		<0 20 0 50 2 0 4500 4000 0 0>,
		<0 20 0 50 3 0 4500 3000 0 0>,
		<0 20 0 50 4 0 4510 2000 1 0>,
		<0 20 50 120 0 0 4500 6000 0 0>,
		<0 20 50 120 1 0 4500 5000 0 0>,
		<0 20 50 120 2 0 4500 4000 0 0>,
		<0 20 50 120 3 0 4500 3000 0 0>,
		<0 20 50 120 4 0 4510 2000 1 0>,
		<0 20 120 160 0 0 4540 6000 0 0>,
		<0 20 120 160 1 0 4540 5000 0 0>,
		<0 20 120 160 2 0 4540 4000 0 0>,
		<0 20 120 160 3 0 4540 3000 0 0>,
		<0 20 120 160 4 0 4550 2200 1 0>,
		<0 20 160 210 0 0 4540 6000 0 0>,
		<0 20 160 210 1 0 4540 5000 0 0>,
		<0 20 160 210 2 0 4540 4000 0 0>,
		<0 20 160 210 3 0 4550 3600 1 0>,
		<0 20 210 350 0 0 4540 6000 0 0>,
		<0 20 210 350 1 0 4540 5000 0 0>,
		<0 20 210 350 2 0 4540 4000 0 0>,
		<0 20 210 350 3 0 4550 3600 1 0>,
		<0 20 350 440 0 0 4539 6000 0 0>,
		<0 20 350 440 1 0 4523 5000 0 0>,
		<0 20 350 440 2 0 4507 4000 0 0>,
		<0 20 350 440 3 0 4491 3000 0 0>,
		<0 20 350 440 4 0 4475 2000 1 0>,
		<0 20 440 510 0 0 4120 6000 0 0>,
		<0 20 440 510 1 0 4120 5000 0 0>,
		<0 20 440 510 2 0 4120 4000 0 0>,
		<0 20 440 510 3 0 4120 3000 0 0>,
		<0 20 440 510 4 0 4130 2000 1 0>,
		<21 35 0 50 0 0 4500 6000 0 0>,
		<21 35 0 50 1 0 4500 5000 0 0>,
		<21 35 0 50 2 0 4500 4000 0 0>,
		<21 35 0 50 3 0 4500 3000 0 0>,
		<21 35 0 50 4 0 4510 2000 1 0>,
		<21 35 50 120 0 0 4500 6000 0 0>,
		<21 35 50 120 1 0 4500 5000 0 0>,
		<21 35 50 120 2 0 4500 4000 0 0>,
		<21 35 50 120 3 0 4500 3000 0 0>,
		<21 35 50 120 4 0 4510 2000 1 0>,
		<21 35 120 160 0 0 4540 6000 0 0>,
		<21 35 120 160 1 0 4540 5000 0 0>,
		<21 35 120 160 2 0 4540 4000 0 0>,
		<21 35 120 160 3 0 4540 3000 0 0>,
		<21 35 120 160 4 0 4550 2200 1 0>,
		<21 35 160 210 0 0 4540 6000 0 0>,
		<21 35 160 210 1 0 4540 5000 0 0>,
		<21 35 160 210 2 0 4540 4000 0 0>,
		<21 35 160 210 3 0 4550 3600 1 0>,
		<21 35 210 350 0 0 4540 6000 0 0>,
		<21 35 210 350 1 0 4540 5000 0 0>,
		<21 35 210 350 2 0 4540 4000 0 0>,
		<21 35 210 350 3 0 4550 3600 1 0>,
		<21 35 350 440 0 0 4539 6000 0 0>,
		<21 35 350 440 1 0 4523 5000 0 0>,
		<21 35 350 440 2 0 4507 4000 0 0>,
		<21 35 350 440 3 0 4491 3000 0 0>,
		<21 35 350 440 4 0 4475 2000 1 0>,
		<21 35 440 510 0 0 4120 6000 0 0>,
		<21 35 440 510 1 0 4120 5000 0 0>,
		<21 35 440 510 2 0 4120 4000 0 0>,
		<21 35 440 510 3 0 4120 3000 0 0>,
		<21 35 440 510 4 0 4130 2000 1 0>,
		<36 55 0 50 0 0 4500 4000 0 0>,
		<36 55 0 50 1 0 4500 3000 0 0>,
		<36 55 0 50 2 0 4510 2000 1 0>,
		<36 55 50 120 0 0 4500 5000 0 0>,
		<36 55 50 120 1 0 4500 4000 0 0>,
		<36 55 50 120 2 0 4500 3000 0 0>,
		<36 55 50 120 3 0 4510 2000 1 0>,
		<36 55 120 160 0 0 4540 6000 0 0>,
		<36 55 120 160 1 0 4540 5000 0 0>,
		<36 55 120 160 2 0 4540 4000 0 0>,
		<36 55 120 160 3 0 4540 3000 0 0>,
		<36 55 120 160 4 0 4550 2200 1 0>,
		<36 55 160 210 0 0 4540 6000 0 0>,
		<36 55 160 210 1 0 4540 5000 0 0>,
		<36 55 160 210 2 0 4540 4000 0 0>,
		<36 55 160 210 3 0 4550 3600 1 0>,
		<36 55 210 350 0 0 4540 6000 0 0>,
		<36 55 210 350 1 0 4540 5000 0 0>,
		<36 55 210 350 2 0 4540 4000 0 0>,
		<36 55 210 350 3 0 4550 3600 1 0>,
		<36 55 350 440 0 0 4539 6000 0 0>,
		<36 55 350 440 1 0 4523 5000 0 0>,
		<36 55 350 440 2 0 4507 4000 0 0>,
		<36 55 350 440 3 0 4491 3000 0 0>,
		<36 55 350 440 4 0 4475 2000 1 0>,
		<36 55 440 510 0 0 4120 6000 0 0>,
		<36 55 440 510 1 0 4120 5000 0 0>,
		<36 55 440 510 2 0 4120 4000 0 0>,
		<36 55 440 510 3 0 4120 3000 0 0>,
		<36 55 440 510 4 0 4130 2000 1 0>,
		<56 75 0 50 0 0 4500 3000 0 0>,
		<56 75 0 50 1 0 4510 2000 1 0>,
		<56 75 50 120 0 0 4500 3000 0 0>,
		<56 75 50 120 1 0 4510 2000 1 0>,
		<56 75 120 160 0 0 4540 5000 0 0>,
		<56 75 120 160 1 0 4540 4000 0 0>,
		<56 75 120 160 2 0 4540 3000 0 0>,
		<56 75 120 160 3 0 4550 2200 1 0>,
		<56 75 160 210 0 0 4540 6000 0 0>,
		<56 75 160 210 1 0 4540 5000 0 0>,
		<56 75 160 210 2 0 4540 4000 0 0>,
		<56 75 160 210 3 0 4550 3600 1 0>,
		<56 75 210 350 0 0 4540 6000 0 0>,
		<56 75 210 350 1 0 4540 5000 0 0>,
		<56 75 210 350 2 0 4540 4000 0 0>,
		<56 75 210 350 3 0 4550 3600 1 0>,
		<56 75 350 440 0 0 4539 6000 0 0>,
		<56 75 350 440 1 0 4523 5000 0 0>,
		<56 75 350 440 2 0 4507 4000 0 0>,
		<56 75 350 440 3 0 4491 3000 0 0>,
		<56 75 350 440 4 0 4475 2000 1 0>,
		<56 75 440 510 0 0 4130 2000 1 0>,
		<76 85 0 50 0 0 4510 2000 1 0>,
		<76 85 50 120 0 0 4500 3000 0 0>,
		<76 85 50 120 1 0 4510 2000 1 0>,
		<76 85 120 160 0 0 4540 4000 0 0>,
		<76 85 120 160 1 0 4540 3000 0 0>,
		<76 85 120 160 2 0 4550 2200 1 0>,
		<76 85 160 210 0 0 4540 5000 0 0>,
		<76 85 160 210 1 0 4540 4000 0 0>,
		<76 85 160 210 2 0 4550 3600 1 0>,
		<76 85 210 350 0 0 4540 6000 0 0>,
		<76 85 210 350 1 0 4540 5000 0 0>,
		<76 85 210 350 2 0 4540 4000 0 0>,
		<76 85 210 350 3 0 4550 3600 1 0>,
		<76 85 350 440 0 0 4539 6000 0 0>,
		<76 85 350 440 1 0 4523 5000 0 0>,
		<76 85 350 440 2 0 4507 4000 0 0>,
		<76 85 350 440 3 0 4491 3000 0 0>,
		<76 85 350 440 4 0 4475 2000 1 0>,
		<76 85 440 510 0 0 4130 2000 1 0>,
		<86 90 0 50 0 0 4510 2000 1 0>,
		<86 90 50 120 0 0 4510 2000 1 0>,
		<86 90 120 160 0 0 4540 3000 0 0>,
		<86 90 120 160 1 0 4550 2200 1 0>,
		<86 90 160 210 0 0 4540 4000 0 0>,
		<86 90 160 210 1 0 4550 3600 1 0>,
		<86 90 210 350 0 0 4540 4000 0 0>,
		<86 90 210 350 1 0 4550 3600 1 0>,
		<86 90 350 440 0 0 4539 6000 0 0>,
		<86 90 350 440 1 0 4523 5000 0 0>,
		<86 90 350 440 2 0 4507 4000 0 0>,
		<86 90 350 440 3 0 4491 3000 0 0>,
		<86 90 350 440 4 0 4475 2000 1 0>,
		<86 90 440 510 0 0 4130 2000 1 0>;
};
