// SPDX-License-Identifier: GPL-2.0-only
/*
 * Iceland third-party PPS strategy from the public OnePlus SM8850 source:
 * kernel_platform/qcom/opensource/devicetree/oplus/oplus_chg/iceland_ivy/
 * oplus-chg-iceland-common.dtsi, pps_charge_third_strategy.
 * Source commit: 8be53e8b737a83a33512d5e0106cccb010a5c24c.
 * Copyright (C) 2020-2024 Oplus. All rights reserved.
 *
 * SOC ranges include both endpoints; temperature ranges exclude the upper
 * endpoint. Currents are subject to the PMIC/cable/adapter limits at runtime.
 */

&charger_pps {
	/* soc_lo soc_hi temp_lo temp_hi gear mV vbat_mV mA flags seconds */
	oplus,pps-charge-curve =
		<0 20 0 50 0 11000 4150 5000 0 0>,
		<0 20 0 50 1 11000 4150 4500 0 0>,
		<0 20 0 50 2 11000 4490 4250 0 0>,
		<0 20 0 50 3 11000 4490 4000 0 0>,
		<0 20 0 50 4 11000 4490 3500 0 0>,
		<0 20 0 50 5 11000 4490 3000 0 0>,
		<0 20 0 50 6 11000 4490 2500 0 0>,
		<0 20 0 50 7 11000 4490 2000 0 0>,
		<0 20 0 50 8 11000 4490 1500 0 0>,
		<0 20 0 50 9 11000 4500 1000 1 0>,
		<0 20 50 120 0 11000 4150 5000 0 0>,
		<0 20 50 120 1 11000 4150 4500 0 0>,
		<0 20 50 120 2 11000 4490 4250 0 0>,
		<0 20 50 120 3 11000 4490 4000 0 0>,
		<0 20 50 120 4 11000 4490 3500 0 0>,
		<0 20 50 120 5 11000 4490 3000 0 0>,
		<0 20 50 120 6 11000 4490 2500 0 0>,
		<0 20 50 120 7 11000 4490 2000 0 0>,
		<0 20 50 120 8 11000 4490 1500 0 0>,
		<0 20 50 120 9 11000 4500 1000 1 0>,
		<0 20 120 160 0 11000 4480 5000 0 0>,
		<0 20 120 160 1 11000 4490 4950 0 0>,
		<0 20 120 160 2 11000 4490 4500 0 0>,
		<0 20 120 160 3 11000 4490 4000 0 0>,
		<0 20 120 160 4 11000 4490 3500 0 0>,
		<0 20 120 160 5 11000 4490 3000 0 0>,
		<0 20 120 160 6 11000 4490 2500 0 0>,
		<0 20 120 160 7 11000 4490 2000 0 0>,
		<0 20 120 160 8 11000 4490 1500 0 0>,
		<0 20 120 160 9 11000 4500 1000 1 0>,
		<0 20 160 210 0 11000 4480 5000 0 0>,
		<0 20 160 210 1 11000 4490 4950 0 0>,
		<0 20 160 210 2 11000 4490 4500 0 0>,
		<0 20 160 210 3 11000 4490 4000 0 0>,
		<0 20 160 210 4 11000 4490 3500 0 0>,
		<0 20 160 210 5 11000 4490 3000 0 0>,
		<0 20 160 210 6 11000 4490 2500 0 0>,
		<0 20 160 210 7 11000 4490 2000 0 0>,
		<0 20 160 210 8 11000 4490 1500 0 0>,
		<0 20 160 210 9 11000 4500 1000 1 0>,
		<0 20 210 350 0 11000 4480 5000 0 0>,
		<0 20 210 350 1 11000 4490 4950 0 0>,
		<0 20 210 350 2 11000 4490 4500 0 0>,
		<0 20 210 350 3 11000 4490 4000 0 0>,
		<0 20 210 350 4 11000 4490 3500 0 0>,
		<0 20 210 350 5 11000 4490 3000 0 0>,
		<0 20 210 350 6 11000 4490 2500 0 0>,
		<0 20 210 350 7 11000 4490 2000 0 0>,
		<0 20 210 350 8 11000 4490 1500 0 0>,
		<0 20 210 350 9 11000 4500 1000 1 0>,
		<0 20 350 440 0 11000 4470 5000 0 0>,
		<0 20 350 440 1 11000 4470 4950 0 0>,
		<0 20 350 440 2 11000 4470 4500 0 0>,
		<0 20 350 440 3 11000 4470 4000 0 0>,
		<0 20 350 440 4 11000 4470 3500 0 0>,
		<0 20 350 440 5 11000 4470 3000 0 0>,
		<0 20 350 440 6 11000 4470 2500 0 0>,
		<0 20 350 440 7 11000 4470 2000 0 0>,
		<0 20 350 440 8 11000 4470 1500 0 0>,
		<0 20 350 440 9 11000 4480 1000 1 0>,
		<0 20 440 510 0 11000 4120 3250 0 0>,
		<0 20 440 510 1 11000 4120 3000 0 0>,
		<0 20 440 510 2 11000 4120 2500 0 0>,
		<0 20 440 510 3 11000 4120 2000 0 0>,
		<0 20 440 510 4 11000 4120 1500 0 0>,
		<0 20 440 510 5 11000 4130 1000 1 0>,
		<21 35 0 50 0 11000 4150 5000 0 0>,
		<21 35 0 50 1 11000 4150 4500 0 0>,
		<21 35 0 50 2 11000 4490 4250 0 0>,
		<21 35 0 50 3 11000 4490 4000 0 0>,
		<21 35 0 50 4 11000 4490 3500 0 0>,
		<21 35 0 50 5 11000 4490 3000 0 0>,
		<21 35 0 50 6 11000 4490 2500 0 0>,
		<21 35 0 50 7 11000 4490 2000 0 0>,
		<21 35 0 50 8 11000 4490 1500 0 0>,
		<21 35 0 50 9 11000 4500 1000 1 0>,
		<21 35 50 120 0 11000 4150 5000 0 0>,
		<21 35 50 120 1 11000 4150 4500 0 0>,
		<21 35 50 120 2 11000 4490 4250 0 0>,
		<21 35 50 120 3 11000 4490 4000 0 0>,
		<21 35 50 120 4 11000 4490 3500 0 0>,
		<21 35 50 120 5 11000 4490 3000 0 0>,
		<21 35 50 120 6 11000 4490 2500 0 0>,
		<21 35 50 120 7 11000 4490 2000 0 0>,
		<21 35 50 120 8 11000 4490 1500 0 0>,
		<21 35 50 120 9 11000 4500 1000 1 0>,
		<21 35 120 160 0 11000 4480 5000 0 0>,
		<21 35 120 160 1 11000 4490 4950 0 0>,
		<21 35 120 160 2 11000 4490 4500 0 0>,
		<21 35 120 160 3 11000 4490 4000 0 0>,
		<21 35 120 160 4 11000 4490 3500 0 0>,
		<21 35 120 160 5 11000 4490 3000 0 0>,
		<21 35 120 160 6 11000 4490 2500 0 0>,
		<21 35 120 160 7 11000 4490 2000 0 0>,
		<21 35 120 160 8 11000 4490 1500 0 0>,
		<21 35 120 160 9 11000 4500 1000 1 0>,
		<21 35 160 210 0 11000 4480 5000 0 0>,
		<21 35 160 210 1 11000 4490 4950 0 0>,
		<21 35 160 210 2 11000 4490 4500 0 0>,
		<21 35 160 210 3 11000 4490 4000 0 0>,
		<21 35 160 210 4 11000 4490 3500 0 0>,
		<21 35 160 210 5 11000 4490 3000 0 0>,
		<21 35 160 210 6 11000 4490 2500 0 0>,
		<21 35 160 210 7 11000 4490 2000 0 0>,
		<21 35 160 210 8 11000 4490 1500 0 0>,
		<21 35 160 210 9 11000 4500 1000 1 0>,
		<21 35 210 350 0 11000 4480 5000 0 0>,
		<21 35 210 350 1 11000 4490 4950 0 0>,
		<21 35 210 350 2 11000 4490 4500 0 0>,
		<21 35 210 350 3 11000 4490 4000 0 0>,
		<21 35 210 350 4 11000 4490 3500 0 0>,
		<21 35 210 350 5 11000 4490 3000 0 0>,
		<21 35 210 350 6 11000 4490 2500 0 0>,
		<21 35 210 350 7 11000 4490 2000 0 0>,
		<21 35 210 350 8 11000 4490 1500 0 0>,
		<21 35 210 350 9 11000 4500 1000 1 0>,
		<21 35 350 440 0 11000 4470 5000 0 0>,
		<21 35 350 440 1 11000 4470 4950 0 0>,
		<21 35 350 440 2 11000 4470 4500 0 0>,
		<21 35 350 440 3 11000 4470 4000 0 0>,
		<21 35 350 440 4 11000 4470 3500 0 0>,
		<21 35 350 440 5 11000 4470 3000 0 0>,
		<21 35 350 440 6 11000 4470 2500 0 0>,
		<21 35 350 440 7 11000 4470 2000 0 0>,
		<21 35 350 440 8 11000 4470 1500 0 0>,
		<21 35 350 440 9 11000 4480 1000 1 0>,
		<21 35 440 510 0 11000 4120 3250 0 0>,
		<21 35 440 510 1 11000 4120 3000 0 0>,
		<21 35 440 510 2 11000 4120 2500 0 0>,
		<21 35 440 510 3 11000 4120 2000 0 0>,
		<21 35 440 510 4 11000 4120 1500 0 0>,
		<21 35 440 510 5 11000 4130 1000 1 0>,
		<36 55 0 50 0 11000 4490 2000 0 0>,
		<36 55 0 50 1 11000 4490 1500 0 0>,
		<36 55 0 50 2 11000 4500 1000 1 0>,
		<36 55 50 120 0 11000 4490 2500 0 0>,
		<36 55 50 120 1 11000 4490 2000 0 0>,
		<36 55 50 120 2 11000 4490 1500 0 0>,
		<36 55 50 120 3 11000 4500 1000 1 0>,
		<36 55 120 160 0 11000 4490 4000 0 0>,
		<36 55 120 160 1 11000 4490 3500 0 0>,
		<36 55 120 160 2 11000 4490 3000 0 0>,
		<36 55 120 160 3 11000 4490 2500 0 0>,
		<36 55 120 160 4 11000 4490 2000 0 0>,
		<36 55 120 160 5 11000 4490 1500 0 0>,
		<36 55 120 160 6 11000 4500 1000 1 0>,
		<36 55 160 210 0 11000 4490 4000 0 0>,
		<36 55 160 210 1 11000 4490 3500 0 0>,
		<36 55 160 210 2 11000 4490 3000 0 0>,
		<36 55 160 210 3 11000 4490 2500 0 0>,
		<36 55 160 210 4 11000 4490 2000 0 0>,
		<36 55 160 210 5 11000 4490 1500 0 0>,
		<36 55 160 210 6 11000 4500 1000 1 0>,
		<36 55 210 350 0 11000 4480 5000 0 0>,
		<36 55 210 350 1 11000 4490 4950 0 0>,
		<36 55 210 350 2 11000 4490 4500 0 0>,
		<36 55 210 350 3 11000 4490 4000 0 0>,
		<36 55 210 350 4 11000 4490 3500 0 0>,
		<36 55 210 350 5 11000 4490 3000 0 0>,
		<36 55 210 350 6 11000 4490 2500 0 0>,
		<36 55 210 350 7 11000 4490 2000 0 0>,
		<36 55 210 350 8 11000 4490 1500 0 0>,
		<36 55 210 350 9 11000 4500 1000 1 0>,
		<36 55 350 440 0 11000 4470 5000 0 0>,
		<36 55 350 440 1 11000 4470 4950 0 0>,
		<36 55 350 440 2 11000 4470 4500 0 0>,
		<36 55 350 440 3 11000 4470 4000 0 0>,
		<36 55 350 440 4 11000 4470 3500 0 0>,
		<36 55 350 440 5 11000 4470 3000 0 0>,
		<36 55 350 440 6 11000 4470 2500 0 0>,
		<36 55 350 440 7 11000 4470 2000 0 0>,
		<36 55 350 440 8 11000 4470 1500 0 0>,
		<36 55 350 440 9 11000 4480 1000 1 0>,
		<36 55 440 510 0 11000 4120 3250 0 0>,
		<36 55 440 510 1 11000 4120 3000 0 0>,
		<36 55 440 510 2 11000 4120 2500 0 0>,
		<36 55 440 510 3 11000 4120 2000 0 0>,
		<36 55 440 510 4 11000 4120 1500 0 0>,
		<36 55 440 510 5 11000 4130 1000 1 0>,
		<56 75 0 50 0 11000 4490 1500 0 0>,
		<56 75 0 50 1 11000 4500 1000 1 0>,
		<56 75 50 120 0 11000 4490 1500 0 0>,
		<56 75 50 120 1 11000 4500 1000 1 0>,
		<56 75 120 160 0 11000 4490 2500 0 0>,
		<56 75 120 160 1 11000 4490 2000 0 0>,
		<56 75 120 160 2 11000 4490 1500 0 0>,
		<56 75 120 160 3 11000 4500 1000 1 0>,
		<56 75 160 210 0 11000 4490 3000 0 0>,
		<56 75 160 210 1 11000 4490 2500 0 0>,
		<56 75 160 210 2 11000 4490 2000 0 0>,
		<56 75 160 210 3 11000 4490 1500 0 0>,
		<56 75 160 210 4 11000 4500 1000 1 0>,
		<56 75 210 350 0 11000 4490 3000 0 0>,
		<56 75 210 350 1 11000 4490 2500 0 0>,
		<56 75 210 350 2 11000 4490 2000 0 0>,
		<56 75 210 350 3 11000 4490 1500 0 0>,
		<56 75 210 350 4 11000 4500 1000 1 0>,
		<56 75 350 440 0 11000 4470 3500 0 0>,
		<56 75 350 440 1 11000 4470 3000 0 0>,
		<56 75 350 440 2 11000 4470 2500 0 0>,
		<56 75 350 440 3 11000 4470 2000 0 0>,
		<56 75 350 440 4 11000 4470 1500 0 0>,
		<56 75 350 440 5 11000 4480 1000 1 0>,
		<56 75 440 510 0 11000 4130 1000 1 0>,
		<76 85 0 50 0 11000 4500 1000 1 0>,
		<76 85 50 120 0 11000 4490 1500 0 0>,
		<76 85 50 120 1 11000 4500 1000 1 0>,
		<76 85 120 160 0 11000 4490 2000 0 0>,
		<76 85 120 160 1 11000 4490 1500 0 0>,
		<76 85 120 160 2 11000 4500 1000 1 0>,
		<76 85 160 210 0 11000 4490 2500 0 0>,
		<76 85 160 210 1 11000 4490 2000 0 0>,
		<76 85 160 210 2 11000 4490 1500 0 0>,
		<76 85 160 210 3 11000 4500 1000 1 0>,
		<76 85 210 350 0 11000 4490 3000 0 0>,
		<76 85 210 350 1 11000 4490 2500 0 0>,
		<76 85 210 350 2 11000 4490 2000 0 0>,
		<76 85 210 350 3 11000 4490 1500 0 0>,
		<76 85 210 350 4 11000 4500 1000 1 0>,
		<76 85 350 440 0 11000 4470 3000 0 0>,
		<76 85 350 440 1 11000 4470 2500 0 0>,
		<76 85 350 440 2 11000 4470 2000 0 0>,
		<76 85 350 440 3 11000 4470 1500 0 0>,
		<76 85 350 440 4 11000 4480 1000 1 0>,
		<76 85 440 510 0 11000 4130 1000 1 0>,
		<86 90 0 50 0 11000 4500 1000 1 0>,
		<86 90 50 120 0 11000 4500 1000 1 0>,
		<86 90 120 160 0 11000 4490 1500 0 0>,
		<86 90 120 160 1 11000 4500 1000 1 0>,
		<86 90 160 210 0 11000 4490 2000 0 0>,
		<86 90 160 210 1 11000 4490 1500 0 0>,
		<86 90 160 210 2 11000 4500 1000 1 0>,
		<86 90 210 350 0 11000 4490 2000 0 0>,
		<86 90 210 350 1 11000 4490 1500 0 0>,
		<86 90 210 350 2 11000 4500 1000 1 0>,
		<86 90 350 440 0 11000 4470 2500 0 0>,
		<86 90 350 440 1 11000 4470 2000 0 0>,
		<86 90 350 440 2 11000 4470 1500 0 0>,
		<86 90 350 440 3 11000 4480 1000 1 0>,
		<86 90 440 510 0 11000 4130 1000 1 0>;
};
